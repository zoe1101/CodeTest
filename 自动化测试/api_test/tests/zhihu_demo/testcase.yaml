## 自动化测试/api_test/tests/zhihu_demo/testcase.yaml
```yaml
config: # 测试信息
  env: zhihu_demo


variable:
  none : none
tests:
  test_login:
    is_run: True
    description: "知乎登录"
    host: https://www.zhixue.com
    method: post
    route: /weakPwdLogin/?from=web_login
    RequestData:
      data:
        loginName: 18291900215
        password: dd636482aca022
        code:
        description: encrypt
    Validate:
#      expectcode: 200
      - eq: [status_code, 200]
```
